## vscode-bitbake-build/conf/bblayers.conf
```bitbake
# LAYER_CONF_VERSION is increased each time build/conf/bblayers.conf
# changes incompatibly
LCONF_VERSION = "8"

BBPATH = "${TOPDIR}"
BBFILES ?= ""

BBLAYERS ?= " \
  /home/itlinux/aspeed/openbmc/meta \
  /home/itlinux/aspeed/openbmc/meta-poky \
  /home/itlinux/aspeed/openbmc/meta-openembedded/meta-oe \
  /home/itlinux/aspeed/openbmc/meta-openembedded/meta-networking \
  /home/itlinux/aspeed/openbmc/meta-openembedded/meta-perl \
  /home/itlinux/aspeed/openbmc/meta-openembedded/meta-python \
  /home/itlinux/aspeed/openbmc/meta-security \
  /home/itlinux/aspeed/openbmc/meta-phosphor \
  "
BBLAYERS_NON_REMOVABLE ?= " \
  /home/itlinux/aspeed/openbmc/meta \
  /home/itlinux/aspeed/openbmc/meta-poky \
  /home/itlinux/aspeed/openbmc/meta-openembedded/meta-oe \
  /home/itlinux/aspeed/openbmc/meta-openembedded/meta-networking \
  /home/itlinux/aspeed/openbmc/meta-openembedded/meta-perl \
  /home/itlinux/aspeed/openbmc/meta-openembedded/meta-python \
  /home/itlinux/aspeed/openbmc/meta-security \
  /home/itlinux/aspeed/openbmc/meta-phosphor \
  "
```
